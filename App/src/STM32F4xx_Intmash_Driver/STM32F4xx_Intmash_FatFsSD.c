#include "STM32F4xx_Intmash_FatFsSD.h"

/*
файлы STM32F4xx_Intmash_FatFsSD.h и STM32F4xx_Intmash_FatFsSD.с подключаются к проекту при необходимости
автоматизации работы с sd картой. 
Единственная функция void fs_proc_run(void)  проверяет есть ли диск, 
какое было предыдущее состояние системы, инициализирована система или нет, 
смонтировано дисковое пространство или нет, и производит необходимые действия
(чтобы система вдруг не зависала в момент вытаскивания карточки или чтобы
система начинала работать, если карту вдруг решили вставить)

описание переменной состояния диска
  FDiskState = 7(111)
                 |||_STA_NOINIT - не инициализировн
                 ||_STA_NODISK - нет диска (SD карты)
                 |_STA_PROTECT

описание переменной готовности файловой системы
FSReady = FAT_NOT_READY - файловая система не смонтирована, работать с ней нельзя
FSReady = FAT_READY - файловая система смонтирована, можно работать
FSReady = FAT_MOUNT_ERROR - проверена и не может быть смонтирована (не фат)

*/

volatile BYTE FDiskState = STA_NODISK | STA_NOINIT;//текущее состояние диска
volatile BYTE FSReady = FAT_NOT_READY;//Состояние файловой системы - используется в других модулях программы
FATFS fs[1]; //Структура файловой системы, 1 - у нас на диске только одна система 
FATFS *pFS = &fs[0]; //указатель на fs - используется в других модулях программы
char Path=0; // Logical drive number to be mounted/unmounted - у нас однодисковая система - нулевой номер
const TCHAR* path = &Path;


DWORD fre_clust; //количество свободных кластеров на диске
DWORD fre_sect; //размер свободной области диска в кб
DWORD tot_sect; //общий размер диска в кб

BYTE  DiskState = STA_NODISK | STA_NOINIT;//состояние диска в предыдущем цикле


/*функция работы с sd и файловой системой*/
/**
  @brief  Автоматический монтаж/демонтаж файловой системы в зависимости от состояния диска.
    Остальные модули программы получают состояние файловой системы через глобальную переменную FSReady


В функции всегда происходит проверка на наличие диска и одно из трех следующих действий:
1. проверка на наличие диска и размонитрование файловой системы, если необходимо
2. инициализация вставленного диска
3. монитрование файловой системы, если это необходимо
  @param  none
  @retval none.
  */
void fs_proc_run(void){

  //проверка на наличие диска
  if (disk_status(0) & STA_NODISK) FDiskState |= (STA_NODISK | STA_NOINIT); 
  else FDiskState &= ~STA_NODISK;
  //1. проверка на наличие диска и размонитрование файловой системы, если необходимо
  if (FDiskState & STA_NODISK) //смотрим состояние диска - его нет в слоте (STA_NODISK)
  {
    if (DiskState == 0) //смотрим предыдущее состояния диска
    {
      //в предыдущий период диск был вставлен, значит его извлекли
      if (FSReady) //если система была смонтирована/ была неопознана - размонтируем
      {
        f_mount ( NULL, path, 1);//unmount - размонтирую файловую систему
        FSReady = FAT_NOT_READY;//ставлю признак того что файловая система размонтирована
      }
    }
    DiskState = FDiskState; //сохраняем состояние диска 
    return;//диска нет, файловая система размонтирована - Выходим из функции
  }
  //2. инициализация вставленного диска
  if (FDiskState & STA_NOINIT) //диск вставлен, но не инициализирован 
  {   
    if (DiskState & STA_NOINIT) //смотрим, был ли раньше диск инициализирован?
    { //не был - пробуем инициализировать
      if (disk_initialize(0) == 0) //диск инициализировался без ошибок
      {
        FDiskState &= ~STA_NOINIT; //сбрасываем флаг отсутствия инициализации
      }
    }
    DiskState = FDiskState; //сохраняем состояние диска (иници или не иниц)
    return;//диск вставлен, файловая система или иниц, или будет пытаться инициализироваться в следущий заход в функцию
  }
  
  //3. монитрование файловой системы, если это необходимо
  if (FDiskState == 0) //диск вставлен и инициализирован
  { 
    if (FSReady == FAT_NOT_READY) //если файловая система не смонтирована и не проверена
    { 
      BYTE fmt = check_fs(fs, 0);
      if (fmt > 2)FSReady = FAT_MOUNT_ERROR; //система НЕ фат и не может быть смонтирована  
      //монтирую файловую систему (DISK:0)
      else if (f_mount (&fs[0], path, 1) == FR_OK) //если файловая система инициализировалась без ошибок
      {
        if (f_getfree("/", &fre_clust, &pFS) == 0) //проверяю общий размер и наличие свободного места
        {
          tot_sect = ((fs->n_fatent - 2) * fs->csize) >> 1; //общий объем диска в кб
          fre_sect = (fre_clust * fs->csize) >> 1; //размер свободной части в кб
          DiskState = FDiskState; //сохраняем состояние диска неа всякий случай
          FSReady = FAT_READY; //файловая система смонтирована
          return; 
        }
      }
      else FSReady = FAT_MOUNT_ERROR;
    }
  }
  
}


